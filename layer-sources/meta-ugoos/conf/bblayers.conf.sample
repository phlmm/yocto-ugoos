## layer-sources/meta-ugoos/conf/bblayers.conf.sample
```bitbake
# POKY_BBLAYERS_CONF_VERSION is increased each time build/conf/bblayers.conf
# changes incompatibly
POKY_BBLAYERS_CONF_VERSION = "1"

BBPATH = "${TOPDIR}"
BBFILES ?= ""

BBLAYERS ?= " \
  ##OEROOT##/../poky \
  ##OEROOT##/../meta-openembedded \
  ##OEROOT##/../meta-ugoos \
  ##OEROOT##/../meta-kodi \
  ##OEROOT##/../meta-meson \
  "
```

## layer-sources/meta-ugoos/conf/layer.conf
```bitbake
# We might have a conf and classes directory, append to BBPATH
BBPATH .= ":${LAYERDIR}"

# We have a recipes directory, add to BBFILES
BBFILES += "${LAYERDIR}/recipes*/*/*.bb ${LAYERDIR}/recipes*/*/*.bbappend"

BBFILE_COLLECTIONS += "meta-ugoos"
BBFILE_PATTERN_meta-ugoos := "^${LAYERDIR}/"
BBFILE_PRIORITY_meta-ugoos = "7"

LAYERDEPENDS_meta-ugoos = "networking-layer multimedia-layer core openembedded-layer"
LAYERSERIES_COMPAT_meta-ugoos = "dunfell gatesgarth hardknott honister"
```

## layer-sources/meta-ugoos/conf/machine/include/ugoos-am6-s922x-dtb.inc
```bitbake
# Khadas VIM3 with S922X

KERNEL_DEVICETREE += "amlogic/meson-g12b-ugoos-am6.dtb"
IMAGE_BOOT_FILES += "meson-g12b-ugoos-am6.dtb:meson-g12b-ugoos-am6.dtb"
```

## layer-sources/meta-ugoos/conf/machine/ugoos-am6.conf
```bitbake
# Ugoos am6 board

require conf/machine/include/amlogic-s922x.inc
require conf/machine/include/ugoos-am6-s922x-dtb.inc

KERNEL_IMAGETYPE = "uImage"


EXTRA_IMAGEDEPENDS += "s905-autoscript s905-autoscript-multiboot"

IMAGE_BOOT_FILES += " uImage "
IMAGE_BOOT_FILES +=  " s905_autoscript aml_autoscript aml_autoscript.zip "

MACHINE_FEATURES_append-ugoos-am6 += "bluetooth rtc keyboard usbhost usbgadget wifi"
#IMAGE_BOOT_FILES_append = " Image "

PREFERRED_PROVIDER_amlogic-fip = "amlogic-fip-prebuilt"
PREFERRED_PROVIDER_virtual/bootloader = "u-boot-meson-gx"
PREFERRED_PROVIDER_u-boot = "u-boot-meson-gx"
PREFERRED_VERSION_u-boot-meson-gx = "2021.04%"

UBOOT_MACHINE = "odroid-n2_config"
UBOOT_EXTLINUX = "1"
# Boot on SDCard
UBOOT_EXTLINUX_ROOT_ugoos-am6 = "root=/dev/mmcblk1p1"
UBOOT_EXTLINUX_FDT_ugoos-am6 = "../meson-gxbb-odroidn2.dtb"
UBOOT_EXTLINUX_CONSOLE_ugoos-am6 = "console=ttyAML0"

MACHINE_ESSENTIAL_EXTRA_RDEPENDS_ugoos-am6 += " \
       kernel-image \
       kernel-devicetree \
       u-boot-meson-gx \
"

WIC_COMMAND_ugoos-am6 = "wic_command_meson_gxbb"
# Generate an SDCard Image
IMAGE_CLASSES_ugoos-am6 += "image_types_meson"

WKS_FILE_ugoos-am6 = "sdimage-bootpart-ugoos.wks"
```
